VERSION ""

NS_ :

BS_:

BU_: XXX

BO_ 133 NEW_MSG_1: 8 XXX
 SG_ NEW_SIGNAL_1 : 38|15@0+ (1,0) [0|32767] "" XXX

BO_ 146 STEERING: 8 XXX
 SG_ STEER_ANGLE : 23|16@0+ (1,0) [0|65535] "" XXX
 SG_ STEER_ANGLE_RATE : 7|16@0+ (1,0) [0|65535] "" XXX

BO_ 145 NEW_MSG_2: 8 XXX
 SG_ NEW_SIGNAL_1 : 7|16@0+ (1,0) [0|65535] "" XXX
 SG_ NEW_SIGNAL_2 : 23|16@0+ (1,0) [0|65535] "" XXX

BO_ 138 NEW_MSG_3: 8 XXX
